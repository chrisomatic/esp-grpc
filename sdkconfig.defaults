## sdkconfig.defaults
```kconfig
# -----------------------------------------------------------------------
# @lightyear
# -----------------------------------------------------------------------
CONFIG_APP_VERSION_MAJOR=0
CONFIG_APP_VERSION_MINOR=0
CONFIG_APP_VERSION_BUILD=1
CONFIG_LOGGING_ENABLED=n
CONFIG_USE_BLE_SERVER=n
CONFIG_CONSOLE_LOGS_ENABLED=y
CONFIG_USE_BLE_CLIENT=n


# -----------------------------------------------------------------------
# @serial_flasher_config
# -----------------------------------------------------------------------
CONFIG_ESPTOOLPY_PORT="/dev/ttyUSB0"
CONFIG_ESPTOOLPY_BAUD_230400B=y
CONFIG_ESPTOOLPY_BAUD=230400
CONFIG_ESPTOOLPY_FLASHSIZE_4MB=y
CONFIG_ESPTOOLPY_FLASHSIZE="4MB"
CONFIG_ESPTOOLPY_FLASHFREQ_80M=y
CONFIG_ESPTOOLPY_FLASHFREQ="80m"

# -----------------------------------------------------------------------
# @freertos
# -----------------------------------------------------------------------
CONFIG_FREERTOS_HZ=1000
CONFIG_FREERTOS_QUEUE_REGISTRY_SIZE=10
CONFIG_FREERTOS_USE_TRACE_FACILITY=y
CONFIG_FREERTOS_USE_STATS_FORMATTING_FUNCTIONS=y
CONFIG_FREERTOS_VTASKLIST_INCLUDE_COREID=y

# -----------------------------------------------------------------------
# @esp32-specific
# -----------------------------------------------------------------------
CONFIG_ESP32_DEFAULT_CPU_FREQ_240=y
CONFIG_ESP32_DEFAULT_CPU_FREQ_MHZ=240

# -----------------------------------------------------------------------
# @common_esp-related
# -----------------------------------------------------------------------
CONFIG_ESP_SYSTEM_EVENT_TASK_STACK_SIZE=3000
CONFIG_ESP_MAIN_TASK_STACK_SIZE=6000
CONFIG_ESP_TIMER_TASK_STACK_SIZE=2048


# -----------------------------------------------------------------------
# @wi-fi
# -----------------------------------------------------------------------
CONFIG_ESP32_WIFI_SW_COEXIST_ENABLE=n
CONFIG_ESP32_WIFI_TASK_PINNED_TO_CORE_1=y
CONFIG_ESP32_WIFI_IRAM_OPT=y
CONFIG_ESP32_WIFI_RX_IRAM_OPT=y

# -----------------------------------------------------------------------
# @lwip
# -----------------------------------------------------------------------
CONFIG_LWIP_TCPIP_TASK_AFFINITY_CPU1=y
CONFIG_LWIP_TCPIP_TASK_AFFINITY=0x1

# -----------------------------------------------------------------------
# @bootloader_config
# -----------------------------------------------------------------------
CONFIG_BOOTLOADER_COMPILER_OPTIMIZATION_SIZE=y
CONFIG_BOOTLOADER_LOG_LEVEL_INFO=y

# -----------------------------------------------------------------------
# @bluetooth
# -----------------------------------------------------------------------
CONFIG_BT_ENABLED=y

# -----------------------------------------------------------------------
# @bluetooth_controller
# -----------------------------------------------------------------------
CONFIG_BTDM_CTRL_MODE_BLE_ONLY=y
CONFIG_BTDM_CTRL_MODEM_SLEEP=n
CONFIG_BTDM_CTRL_BLE_MAX_CONN=1
CONFIG_BTDM_BLE_SCAN_DUPL=n
CONFIG_BTDM_CTRL_PINNED_TO_CORE_0=y
CONFIG_BTDM_CTRL_PINNED_TO_CORE=0
CONFIG_BTDM_BLE_ADV_REPORT_FLOW_CTRL_SUPP=y
CONFIG_BTDM_BLE_ADV_REPORT_FLOW_CTRL_NUM=100
CONFIG_BTDM_BLE_ADV_REPORT_DISCARD_THRSHOLD=20
CONFIG_BTDM_CTRL_HCI_MODE_VHCI=y
CONFIG_BTDM_COEX_BT_OPTIONS=y
CONFIG_BTDM_COEX_BLE_ADV_HIGH_PRIORITY=y

# -----------------------------------------------------------------------
# @bluedroid_options
# -----------------------------------------------------------------------
CONFIG_BT_BLUEDROID_ENABLED=y
CONFIG_BT_BTC_TASK_STACK_SIZE=8192
CONFIG_BT_BLUEDROID_PINNED_TO_CORE_0=y
CONFIG_BT_BLUEDROID_PINNED_TO_CORE=0
CONFIG_BT_BTU_TASK_STACK_SIZE=6000
CONFIG_BT_STACK_NO_LOG=y
CONFIG_BT_BLE_ESTAB_LINK_CONN_TOUT=15
CONFIG_BT_GATTC_ENABLE=n
#CONFIG_BT_GATTC_CACHE_NVS_FLASH=n
#CONFIG_BT_GATTC_CONNECT_RETRY_COUNT=3
```
